## components/mqtt_mode/Kconfig
```kconfig
menu "Irrigation MQTT"

    comment "Wi-Fi and MQTT settings are configured at runtime from the control panel and saved in NVS."

endmenu
```

## components/zigbee_mode/Kconfig
```kconfig
menu "Irrigation Zigbee"

    config IRRIGATION_ENABLE_ZIGBEE_SDK
        bool "Enable ESP Zigbee SDK integration"
        default n
        help
            This project ships with a safe Zigbee mode skeleton. Enable this
            only after adding ESP Zigbee SDK components to the project.

endmenu
```

## sdkconfig.defaults
```kconfig
CONFIG_IDF_TARGET_ESP32C6=y
CONFIG_PARTITION_TABLE_CUSTOM=y
CONFIG_PARTITION_TABLE_CUSTOM_FILENAME="partitions.csv"
CONFIG_ESP_TASK_WDT_EN=y
CONFIG_ESP_TASK_WDT_CHECK_IDLE_TASK_CPU0=y
CONFIG_ESP_TASK_WDT_PANIC=y
CONFIG_ESP_BROWNOUT_DET=y
CONFIG_ESP_BROWNOUT_DET_LVL_SEL_4=y
CONFIG_ESP_MAIN_TASK_STACK_SIZE=8192
CONFIG_LOG_DEFAULT_LEVEL_INFO=y
CONFIG_MQTT_PROTOCOL_311=y
CONFIG_ESP_CONSOLE_UART_DEFAULT=y
# CONFIG_ESP_CONSOLE_USB_SERIAL_JTAG is not set
CONFIG_ZB_ENABLED=y
CONFIG_ZB_ZCZR=y
CONFIG_ZB_RADIO_NATIVE=y
CONFIG_HTTPD_MAX_REQ_HDR_LEN=2048
CONFIG_ESPTOOLPY_FLASHSIZE_4MB=y
CONFIG_ESPTOOLPY_FLASHSIZE="4MB"
CONFIG_BOOTLOADER_APP_ROLLBACK_ENABLE=y
```
